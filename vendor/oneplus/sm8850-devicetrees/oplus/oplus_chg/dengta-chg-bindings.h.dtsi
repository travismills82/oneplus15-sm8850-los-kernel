/* Additional X9 Ultra IC types; retain the shared LOS function numbering. */
#include "oplus-chg-8850.h.dtsi"

#define OPLUS_CHG_IC_VIRTUAL_BOOST		32
#define OPLUS_IC_FUNC_NUM_BOOST_START			1500
#define OPLUS_IC_FUNC_BOOST_SET_CV			(OPLUS_IC_FUNC_NUM_BOOST_START + 0)
#define OPLUS_IC_FUNC_BOOST_ENABLE_OTG_MODE		(OPLUS_IC_FUNC_NUM_BOOST_START + 1)
#define OPLUS_IC_FUNC_BOOST_SET_WORK_MODE		(OPLUS_IC_FUNC_NUM_BOOST_START + 2)
#define OPLUS_IC_FUNC_BOOST_SET_BCL_RATE		(OPLUS_IC_FUNC_NUM_BOOST_START + 3)
#define OPLUS_IC_FUNC_BOOST_SET_BCL_VOL			(OPLUS_IC_FUNC_NUM_BOOST_START + 4)
#define OPLUS_IC_FUNC_BOOST_GET_IN_CV_MODE		(OPLUS_IC_FUNC_NUM_BOOST_START + 5)
#define OPLUS_IC_FUNC_BOOST_GET_CV			(OPLUS_IC_FUNC_NUM_BOOST_START + 6)
#define OPLUS_IC_FUNC_BOOST_SET_FAM_EN			(OPLUS_IC_FUNC_NUM_BOOST_START + 7)
#define OPLUS_IC_FUNC_BOOST_IS_SUSPEND			(OPLUS_IC_FUNC_NUM_BOOST_START + 8)
#define OPLUS_IC_FUNC_BOOST_SET_SUSPEND_RESUME_CV	(OPLUS_IC_FUNC_NUM_BOOST_START + 9)
#define OPLUS_CHG_SPEC_VER_V3P7_2	4
#define HYBRID_BOOST		0
#define RG_CP			1
