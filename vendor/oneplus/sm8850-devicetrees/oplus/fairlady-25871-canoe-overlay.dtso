// SPDX-License-Identifier: BSD-3-Clause
/dts-v1/;
/plugin/;

#include "fairlady-25871-canoe.dtsi"
#include "fairlady-canoe-common.dtsi"
#include "../qcom/camera/oplus/fairlady-camera-sensor-mtp-EVB-export.dtsi"

/ {
	oplus,hw-id = <OPLUS_EVB1 OPLUS_EVB2 OPLUS_T0 OPLUS_T1 OPLUS_EVT1 OPLUS_EVT2 OPLUS_DVT1 OPLUS_DVT2 OPLUS_PVT1>;
};
