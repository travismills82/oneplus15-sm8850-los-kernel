#include "../qcom/canoe-mtp-overlay.dtso"
#include <dt-bindings/oplus/hw-id.h>
#include "canoe_overlay_common.dtsi"
#include "dengta_overlay_common.dtsi"
#include "mm/dengta-25021-canoe-mm.dtsi"
#include "security/dengta-25021-canoe-security.dtsi"
#include "sensor/dengta-sensor-25021.dtsi"
#include "tp/dengta-oplus-tp-25021.dtsi"
#include "oplus_misc/oplus-misc-25211.dtsi"
#include "oplus_icc/dengta-25021-icc.dtsi"
#include "oplus_chg/oplus-chg-25021.dtsi"
#include "oplus_chg/oplus-chg-25211.dtsi"
#include "oplus_nfc/dengta-sn220.dtsi"
#include "oplus_uff/oplus-uff-25021.dtsi"

#include "dengta-canoe-common.dtsi"

/ {
    model = "Qualcomm Technologies, Inc. Canoe MTP,dengta";
    oplus,project-id = <25211 25212>;
};
