// SPDX-License-Identifier: BSD-3-Clause
/dts-v1/;
/plugin/;

#include "infiniti-24831-canoe.dtsi"
#include "infiniti-canoe-common.dtsi"
#include "../qcom/audio/oplus/infiniti-audio-gpio.dtsi"
#include "../qcom/camera/oplus/infiniti-camera-sensor-mtp-T0.dtsi"

/ {
	oplus,project-id = <24831>;
	oplus,hw-id = <OPLUS_PVT1 OPLUS_EVT1 OPLUS_DVT2 OPLUS_EVT2 OPLUS_DVT1>;
};
