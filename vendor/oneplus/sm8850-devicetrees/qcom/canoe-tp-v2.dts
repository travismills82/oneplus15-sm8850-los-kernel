// SPDX-License-Identifier: BSD-3-Clause
/*
 * Copyright (c) 2024 Qualcomm Innovation Center, Inc. All rights reserved.
 */

/dts-v1/;

#include "canoe-tp-v2.dtsi"
#include "canoe-v2-techpacks.dtsi"

#include "data/canoe-ipa.dtsi"
#include "data/smem-mailbox.dtsi"

/ {
		model = "Qualcomm Technologies, Inc. Canoe Alt. Thermal Profile v2 SoC";
		compatible = "qcom,canoe";
		qcom,board-id = <0 0>;
};
