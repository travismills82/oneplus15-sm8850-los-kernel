// SPDX-License-Identifier: BSD-3-Clause
/*
 * Copyright (c) 2024 Qualcomm Innovation Center, Inc. All rights reserved.
 */

/dts-v1/;

#include "canoe.dtsi"
#include "canoe-techpacks.dtsi"

#include "data/canoe-ipa.dtsi"
#include "data/smem-mailbox.dtsi"

/ {
	model = "Qualcomm Technologies, Inc. Canoe SoC";
	compatible = "qcom,canoe";
	qcom,board-id = <0 0>;
};
