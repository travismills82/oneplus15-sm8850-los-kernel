/dts-v1/;
/plugin/;

#include <dt-bindings/oplus/hw-id.h>
#include "../canoe-audio-mtp.dts"

#include "canoe-audio-overlay-common.dtsi"
#include "infiniti-24831-audio-canoe-overlay.dtsi"

#include "infiniti-audio-gpio-t0.dtsi"

/ {
	model = "Qualcomm Technologies, Inc. Canoe MTP,infiniti";

	oplus,project-id = <24831 24863>;
	oplus,hw-id = <OPLUS_EVB1 OPLUS_EVB2 OPLUS_EVB3 OPLUS_PRE_T0 OPLUS_T0>;
};
