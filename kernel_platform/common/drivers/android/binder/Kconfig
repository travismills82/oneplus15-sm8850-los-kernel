## kernel_platform/common/drivers/android/binder/Kconfig
```kconfig
# SPDX-License-Identifier: GPL-2.0

config ANDROID_BINDER_IPC_RUST
	tristate "Rust version of Android Binder IPC Driver"
	depends on RUST && MMU && NET
	help
	  This enables the Rust implementation of the Binder driver. At this
	  time, the Rust implementation can only be built as an alternative to
	  the C implementation. A built-in Rust implementation is selected by
	  default and may be overridden with binder.impl=c. A modular Rust
	  implementation is selected with binder.impl=rust.

	  To build this as a GKI module, choose m.
```
